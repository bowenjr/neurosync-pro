## firmware/esp32/main/Kconfig
```kconfig
menu "NeuroSync Pro bench options"

config NSP_BENCH_SYNC_40HZ
    bool "Bench-only 40 Hz sync output on GPIO19"
    default n
    help
        Enables a bench image that drives NSP_GPIO_SYNC (GPIO19) with a
        hardware-timed 40.000 Hz, 50% duty MCPWM square wave after the
        firmware reaches SAFE.

        This is not production firmware. GPIO23 output-enable remains low,
        and all non-sync outputs remain in the safe-low list.

endmenu
```

## firmware/esp32/sdkconfig.defaults
```kconfig
# NeuroSync Pro diagnostic firmware — baseline sdkconfig defaults.
# Applied via `idf.py set-target esp32` + `idf.py build`; the generated
# sdkconfig file itself is gitignored (machine/build-local).

# Target
CONFIG_IDF_TARGET="esp32"

# No Wi-Fi, no Bluetooth for this diagnostic build.
CONFIG_ESP_WIFI_ENABLED=n
CONFIG_BT_ENABLED=n

# On panic, halt rather than reboot into an unknown state. Safe state is
# re-established at the top of app_main on every boot regardless, but
# halting on panic keeps a faulting build from looping.
CONFIG_ESP_SYSTEM_PANIC_PRINT_HALT=y

# Console over the primary UART at a conventional rate.
CONFIG_ESP_CONSOLE_UART_DEFAULT=y
CONFIG_ESP_CONSOLE_UART_BAUDRATE=115200
```
